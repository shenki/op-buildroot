## configs/aspeed_ast2500evb_defconfig
```kconfig
# Architecture
BR2_arm=y

# System
BR2_TARGET_GENERIC_HOSTNAME="ast2500-evb"
BR2_TARGET_GENERIC_ISSUE="Aspeed AST2500 EVB"
BR2_TARGET_GENERIC_ROOT_PASSWD="passw0rd"
BR2_SYSTEM_DHCP="eth0"

# Filesystem
BR2_TARGET_ROOTFS_CPIO=y
BR2_TARGET_ROOTFS_CPIO_XZ=y

# Image
BR2_ROOTFS_POST_IMAGE_SCRIPT="board/aspeed/common/post-image.sh"

# Linux headers same as kernel
BR2_PACKAGE_HOST_LINUX_HEADERS_CUSTOM_6_1=y

# Kernel
BR2_LINUX_KERNEL=y
BR2_LINUX_KERNEL_CUSTOM_VERSION=y
BR2_LINUX_KERNEL_CUSTOM_VERSION_VALUE="6.1.14"
BR2_LINUX_KERNEL_USE_CUSTOM_CONFIG=y
BR2_LINUX_KERNEL_CUSTOM_CONFIG_FILE="board/aspeed/ast2500-evb/linux.config"
BR2_LINUX_KERNEL_DTS_SUPPORT=y
BR2_LINUX_KERNEL_INTREE_DTS_NAME="aspeed-ast2500-evb"
BR2_LINUX_KERNEL_XZ=y

# Boot
BR2_TARGET_UBOOT=y
BR2_TARGET_UBOOT_BUILD_SYSTEM_KCONFIG=y
BR2_TARGET_UBOOT_CUSTOM_GIT=y
BR2_TARGET_UBOOT_CUSTOM_REPO_URL="https://github.com/openbmc/u-boot.git"
BR2_TARGET_UBOOT_CUSTOM_REPO_VERSION="29b2d11d822ee7f9822270c710e1d45cade3ed46"
BR2_TARGET_UBOOT_BOARD_DEFCONFIG="evb-ast2500"
BR2_TARGET_UBOOT_NEEDS_DTC=y
BR2_TARGET_UBOOT_NEEDS_OPENSSL=y
BR2_TARGET_UBOOT_CUSTOM_MAKEOPTS="DEVICE_TREE=ast2500-evb"
BR2_TARGET_UBOOT_CONFIG_FRAGMENT_FILES="board/aspeed/ast2500-evb/uboot.fragment"
BR2_PACKAGE_HOST_UBOOT_TOOLS=y
BR2_PACKAGE_HOST_UBOOT_TOOLS_FIT_SUPPORT=y
BR2_PACKAGE_HOST_GENIMAGE=y

# Target tools
BR2_PACKAGE_MTD=y
BR2_PACKAGE_DROPBEAR=y
BR2_PACKAGE_DROPBEAR_DISABLE_REVERSEDNS=y
```

## configs/aspeed_ast2600evb_defconfig
```kconfig
# Architecture
BR2_arm=y
BR2_cortex_a7=y
BR2_ARM_FPU_VFPV4D16=y

# System
BR2_TARGET_GENERIC_HOSTNAME="ast2600-evb"
BR2_TARGET_GENERIC_ISSUE="Aspeed AST2600 EVB"
BR2_TARGET_GENERIC_ROOT_PASSWD="passw0rd"
BR2_SYSTEM_DHCP="eth0"

# Patches
BR2_GLOBAL_PATCH_DIR="board/aspeed/ast2600-evb/patches"

# Filesystem
BR2_TARGET_ROOTFS_CPIO=y
BR2_TARGET_ROOTFS_CPIO_XZ=y

# Image
BR2_ROOTFS_POST_IMAGE_SCRIPT="board/aspeed/common/post-image.sh"

# Linux headers same as kernel
BR2_PACKAGE_HOST_LINUX_HEADERS_CUSTOM_6_1=y

# Kernel
BR2_LINUX_KERNEL=y
BR2_LINUX_KERNEL_CUSTOM_VERSION=y
BR2_LINUX_KERNEL_CUSTOM_VERSION_VALUE="6.3-rc4"
BR2_LINUX_KERNEL_DEFCONFIG="aspeed_g5"
BR2_LINUX_KERNEL_CONFIG_FRAGMENT_FILES="board/aspeed/ast2600-evb/linux.fragment"
BR2_LINUX_KERNEL_DTS_SUPPORT=y
BR2_LINUX_KERNEL_INTREE_DTS_NAME="aspeed-ast2600-evb"

# Boot
BR2_TARGET_UBOOT=y
BR2_TARGET_UBOOT_BUILD_SYSTEM_KCONFIG=y
BR2_TARGET_UBOOT_CUSTOM_GIT=y
BR2_TARGET_UBOOT_CUSTOM_REPO_URL="https://github.com/openbmc/u-boot.git"
BR2_TARGET_UBOOT_CUSTOM_REPO_VERSION="b0dc9ccd3d21315d69a526fcdb211d995a75d703"
BR2_TARGET_UBOOT_BOARD_DEFCONFIG="evb-ast2600"
BR2_TARGET_UBOOT_NEEDS_DTC=y
BR2_TARGET_UBOOT_CUSTOM_MAKEOPTS="DEVICE_TREE=ast2600-p10bmc"
BR2_TARGET_UBOOT_CONFIG_FRAGMENT_FILES="board/aspeed/ast2600-evb/uboot.fragment"
BR2_PACKAGE_HOST_UBOOT_TOOLS=y
BR2_PACKAGE_HOST_UBOOT_TOOLS_FIT_SUPPORT=y
BR2_PACKAGE_HOST_GENIMAGE=y

# Target tools
BR2_PACKAGE_MTD=y
BR2_PACKAGE_UBOOT_TOOLS=y
BR2_PACKAGE_LIBGPIOD=y
BR2_PACKAGE_LIBGPIOD_TOOLS=y
BR2_PACKAGE_LIBCURL=y
BR2_PACKAGE_LIBCURL_CURL=y
BR2_PACKAGE_LIBCURL_VERBOSE=y
BR2_PACKAGE_LIBFFI=y
BR2_PACKAGE_DROPBEAR=y
BR2_PACKAGE_DROPBEAR_DISABLE_REVERSEDNS=y
BR2_PACKAGE_LRZSZ=y
BR2_PACKAGE_PCIUTILS=y
```

## configs/ppc64le_microwatt_defconfig
```kconfig
BR2_powerpc64le=y
BR2_powerpc_microwatt=y
BR2_OPTIMIZE_2=y
BR2_PACKAGE_GLIBC_KERNEL_COMPAT=y
BR2_BINUTILS_VERSION_2_36_X=y
BR2_TARGET_GENERIC_HOSTNAME="microwatt"
BR2_SYSTEM_DHCP="eth0"
BR2_ENABLE_LOCALE_WHITELIST="C en_AU"
BR2_LINUX_KERNEL=y
BR2_LINUX_KERNEL_DEFCONFIG="microwatt"
BR2_LINUX_KERNEL_IMAGE_TARGET_CUSTOM=y
BR2_LINUX_KERNEL_IMAGE_TARGET_NAME="dtbImage.microwatt.elf"
BR2_PACKAGE_DROPBEAR=y
BR2_PACKAGE_IPERF3=y
BR2_TARGET_ROOTFS_EXT2=y
BR2_TARGET_ROOTFS_INITRAMFS=y
# BR2_TARGET_ROOTFS_TAR is not set
```

## configs/qemu_x86_64_defconfig
```kconfig
# Architecture
BR2_x86_64=y

# System
BR2_SYSTEM_DHCP="eth0"

# Filesystem
BR2_TARGET_ROOTFS_EXT2=y
# BR2_TARGET_ROOTFS_TAR is not set

# Image
BR2_ROOTFS_POST_BUILD_SCRIPT="board/qemu/x86_64/post-build.sh"

# Image
BR2_ROOTFS_POST_IMAGE_SCRIPT="board/qemu/post-image.sh"
BR2_ROOTFS_POST_SCRIPT_ARGS="$(BR2_DEFCONFIG)"

# Linux headers same as kernel
BR2_PACKAGE_HOST_LINUX_HEADERS_CUSTOM_5_15=y

# Kernel
BR2_LINUX_KERNEL=y
BR2_LINUX_KERNEL_CUSTOM_VERSION=y
BR2_LINUX_KERNEL_CUSTOM_VERSION_VALUE="5.15"
BR2_LINUX_KERNEL_USE_CUSTOM_CONFIG=y
BR2_LINUX_KERNEL_CUSTOM_CONFIG_FILE="board/qemu/x86_64/linux.config"
BR2_LINUX_KERNEL_NEEDS_HOST_LIBELF=y

# host-qemu for gitlab testing
BR2_PACKAGE_HOST_QEMU=y
BR2_PACKAGE_HOST_QEMU_SYSTEM_MODE=y

# Packages and options for libgpiod testing
BR2_TOOLCHAIN_BUILDROOT_GLIBC=y
BR2_PACKAGE_BUSYBOX_SHOW_OTHERS=y
BR2_PACKAGE_BATS_CORE=y
BR2_PACKAGE_DROPBEAR=y
BR2_PACKAGE_BASH=y
```

## package/mboxbridge/Config.in
```kconfig
config BR2_PACKAGE_MBOXBRIDGE
	bool "mboxbridge"
	help
          This package is used by OpenPower Power9 BMC systems to expose boot
	  firmware to the host CPU.

	  https://github.com/openbmc/mboxbridge
```

## package/memboot/Config.in
```kconfig
config BR2_PACKAGE_MEMBOOT
	bool "memboot"
	depends on BR2_arm
	help
	  Boot your OpenPower PNOR firmware from memory
```

## package/pdbg/Config.in
```kconfig
config BR2_PACKAGE_PDBG
	bool "pflash"
	depends on BR2_arm || BR2_powerpc64 || BR2_powerpc64le || BR2_x86_64
	help
	  PowerPC FSI Debugger, for low level debugging of a PowerPC CPU
	  over FSI
```

## package/pflash/Config.in
```kconfig
config BR2_PACKAGE_PFLASH
	bool "pflash"
	depends on BR2_arm || BR2_powerpc64 || BR2_powerpc64le || BR2_x86_64
	help
	  PNOR Flash reading and writing tool for OpenPower servers. Used for
	  firmware upgrades and extracting diagnostic infromation from flash.
```
